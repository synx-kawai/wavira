## esp-csi/examples/get-started/csi_recv/main/Kconfig.projbuild
```kconfig
menu "Wavira CSI MQTT Configuration"

    choice CSI_OUTPUT_MODE
        prompt "CSI Data Output Mode"
        default CSI_OUTPUT_SERIAL
        help
            Select how CSI data should be output.
            Serial mode outputs to UART (for development).
            MQTT mode sends to a broker via Wi-Fi.

        config CSI_OUTPUT_SERIAL
            bool "Serial Output (UART)"
            help
                Output CSI data to serial port (traditional mode).
                Use this for development and debugging with PC-connected ESP32.

        config CSI_OUTPUT_MQTT
            bool "MQTT Output (Wi-Fi)"
            help
                Send CSI data to MQTT broker via Wi-Fi.
                Use this for production deployment.
    endchoice

    menu "Wi-Fi Configuration"
        depends on CSI_OUTPUT_MQTT

        config WAVIRA_WIFI_SSID
            string "Wi-Fi SSID"
            default "myssid"
            help
                SSID (network name) for the ESP32 to connect to.

        config WAVIRA_WIFI_PASSWORD
            string "Wi-Fi Password"
            default "mypassword"
            help
                Wi-Fi password (WPA or WPA2) for the network.

        config WAVIRA_WIFI_MAXIMUM_RETRY
            int "Maximum retry attempts"
            default 10
            help
                Maximum number of retry attempts for Wi-Fi connection.
                Set to 0 for infinite retries.

        config WAVIRA_WIFI_SCAN_AUTH_MODE_THRESHOLD
            int "Wi-Fi Scan auth mode threshold"
            default 3
            help
                0 = OPEN, 1 = WEP, 2 = WPA_PSK, 3 = WPA2_PSK,
                4 = WPA_WPA2_PSK, 5 = WPA3_PSK, 6 = WPA2_WPA3_PSK
    endmenu

    menu "MQTT Broker Configuration"
        depends on CSI_OUTPUT_MQTT

        config WAVIRA_MQTT_BROKER_URL
            string "Broker URL"
            default "mqtt://192.168.1.100"
            help
                Full URL of the MQTT broker.
                Example: mqtt://192.168.1.100 or mqtts://example.com

        config WAVIRA_MQTT_PORT
            int "Broker Port"
            default 1883
            help
                MQTT broker port (default 1883 for TCP, 8883 for SSL).

        config WAVIRA_MQTT_USERNAME
            string "Username"
            default ""
            help
                MQTT username (leave empty if not required).

        config WAVIRA_MQTT_PASSWORD
            string "Password"
            default ""
            help
                MQTT password (leave empty if not required).
                
        config WAVIRA_MQTT_TOPIC_PREFIX
            string "Topic Prefix"
            default "wavira"
            help
                Prefix for MQTT topics. 
                Data will be published to [prefix]/csi/[device_id]
                
        config WAVIRA_MQTT_QOS
            int "QoS Level"
            default 0
            range 0 2
            help
                MQTT Quality of Service level (0, 1, or 2).
    endmenu

    menu "Device Configuration"
        depends on CSI_OUTPUT_MQTT

        config WAVIRA_DEVICE_ID
            string "Device ID"
            default "esp32-001"
            help
                Unique identifier for this ESP32 device.
                Used in MQTT topic and payload.

        config WAVIRA_DEVICE_ZONE
            string "Device Zone"
            default "default"
            help
                Zone identifier where this device is installed.
                Used for spatial organization.
    endmenu

    menu "Data Buffering Configuration"
        depends on CSI_OUTPUT_MQTT

        config WAVIRA_BUFFER_SIZE
            int "Ring Buffer Size"
            default 20
            range 5 100
            help
                Number of CSI packets to buffer before sending.
                Larger values reduce network overhead but increase latency and memory usage.

        config WAVIRA_BATCH_SIZE
            int "Batch Size"
            default 5
            range 1 50
            help
                Number of CSI packets to send in each MQTT message.
                Must be less than or equal to buffer size.

        config WAVIRA_SEND_INTERVAL_MS
            int "Send Interval (ms)"
            default 100
            range 50 1000
            help
                Minimum interval between batch MQTT sends in milliseconds.
    endmenu

    menu "CSI Trigger Configuration"
        choice CSI_TRIGGER_MODE
            prompt "CSI Trigger Mode"
            default CSI_TRIGGER_ESPNOW
            help
                Select how CSI measurements are triggered.

            config CSI_TRIGGER_ESPNOW
                bool "ESP-NOW (Sender Device)"
                help
                    Use ESP-NOW protocol with a dedicated sender device.
                    Best for controlled environments with multiple ESP32s.

            config CSI_TRIGGER_ROUTER
                bool "Router Ping"
                depends on CSI_OUTPUT_MQTT
                help
                    Ping the connected router to trigger CSI measurements.
                    Simpler setup but may have more interference.
        endchoice

        config CSI_TRIGGER_FREQUENCY
            int "Trigger Frequency (Hz)"
            default 10
            range 1 100
            help
                How many CSI measurements to trigger per second.
    endmenu

    config WAVIRA_LED_GPIO
        int "Status LED GPIO"
        default 2
        range 0 48
        help
            GPIO pin for status LED.
            LED indicates connection and transmission status.

    config WAVIRA_DEBUG_SERIAL
        bool "Enable Debug Serial Output"
        default y
        help
            Enable debug messages on serial port even in MQTT mode.
            Useful for debugging but increases power consumption.

endmenu
```

## esp-csi/examples/get-started/csi_recv_router/sdkconfig.defaults
```kconfig
#
# Wi-Fi
#
CONFIG_ESP32_WIFI_CSI_ENABLED=y
CONFIG_ESP32_WIFI_AMPDU_TX_ENABLED=
CONFIG_ESP32_WIFI_DYNAMIC_RX_BUFFER_NUM=128

#
# UART 
#
CONFIG_ESP_CONSOLE_UART_CUSTOM=y
CONFIG_ESP_CONSOLE_UART=y
CONFIG_ESP_CONSOLE_UART_NUM=0
CONFIG_ESP_CONSOLE_UART_BAUDRATE=115200

CONFIG_ESP_TASK_WDT_TIMEOUT_S=30

CONFIG_ESPTOOLPY_MONITOR_BAUD_115200B=y
CONFIG_ESPTOOLPY_MONITOR_BAUD=115200


#
# Wi-Fi
#
CONFIG_ESP32_WIFI_CSI_ENABLED=y
CONFIG_ESP32_WIFI_AMPDU_TX_ENABLED=
CONFIG_ESP32_WIFI_AMPDU_RX_ENABLED=

#
# Compiler options
#
CONFIG_COMPILER_OPTIMIZATION_PERF=y

#
# FreeRTOS
#
CONFIG_FREERTOS_HZ=1000

#
# ESP32-specific
#
CONFIG_ESP32_DEFAULT_CPU_FREQ_240=y
CONFIG_ESP32_DEFAULT_CPU_FREQ_MHZ=240

CONFIG_ESP32_WIFI_DYNAMIC_TX_BUFFER_NUM=32

#
# ESP32S3-specific
#
CONFIG_ESP32S3_DEFAULT_CPU_FREQ_240=y
CONFIG_ESP32S3_DEFAULT_CPU_FREQ_MHZ=240

# Flash size 4MB
CONFIG_ESPTOOLPY_FLASHSIZE_4MB=y
CONFIG_ESPTOOLPY_FLASHSIZE="4MB"
```

## esp-csi/examples/get-started/csi_recv_router/sdkconfig.defaults.esp32
```kconfig
# Wi-Fi Configuration
CONFIG_EXAMPLE_WIFI_SSID="msdfreeap"
CONFIG_EXAMPLE_WIFI_PASSWORD="relfdsa23g5"

# Wi-Fi CSI
CONFIG_ESP32_WIFI_CSI_ENABLED=y
CONFIG_ESP32_WIFI_AMPDU_TX_ENABLED=
CONFIG_ESP32_WIFI_DYNAMIC_RX_BUFFER_NUM=128

# UART
CONFIG_ESP_CONSOLE_UART_CUSTOM=y
CONFIG_ESP_CONSOLE_UART=y
CONFIG_ESP_CONSOLE_UART_NUM=0
CONFIG_ESP_CONSOLE_UART_BAUDRATE=115200

CONFIG_ESP_TASK_WDT_TIMEOUT_S=30

CONFIG_ESPTOOLPY_MONITOR_BAUD_115200B=y
CONFIG_ESPTOOLPY_MONITOR_BAUD=115200

# Compiler options
CONFIG_COMPILER_OPTIMIZATION_PERF=y

# FreeRTOS
CONFIG_FREERTOS_HZ=1000

# ESP32-specific
CONFIG_ESP32_DEFAULT_CPU_FREQ_240=y
CONFIG_ESP32_DEFAULT_CPU_FREQ_MHZ=240
CONFIG_ESP32_WIFI_DYNAMIC_TX_BUFFER_NUM=32
```
